#include <Wire.h>
#include <Adafruit_SSD1306.h>
#include <Adafruit_GFX.h>
#include <SPI.h>
#include <MFRC522.h>

#define ANCHOPANTALLA 128
#define ALTOPANTALLA 64
#define RESETOLED -1
Adafruit_SSD1306 pantalla(ANCHOPANTALLA, ALTOPANTALLA, &Wire, RESETOLED);

#define PINSS 5
#define PINRST 27
MFRC522 lectorRFID(PINSS, PINRST);

#define PINLED 2
#define TIEMPOLEDENCENDIDO 3000 // Tiempo en milisegundos (5 segundos)

#define MAXINTENTOSESCANEO 3 // Máximo número de intentos de escaneo por día

unsigned long ultimoMillisEscanear = 0;
bool estadoLED = false;
int intentosEscanearHoy = MAXINTENTOSESCANEO;

// '580b57fcd9996e24bc43c39c (1)', 67x64px
const unsigned char epd_bitmap_580b57fcd9996e24bc43c39c__1_ [] PROGMEM = {
  0x00, 0x00, 0x00, 0x00, 0x00, 0x00, 0x00, 0x00, 0x00, 0x00, 0x00, 0x00, 0x00, 0x00, 0x00, 0x00, 
  0x00, 0x00, 0x00, 0x00, 0x00, 0x3c, 0x00, 0x00, 0x00, 0x00, 0x00, 0x00, 0x00, 0x00, 0xff, 0x80, 
  0x00, 0x00, 0x00, 0x00, 0x00, 0x00, 0x00, 0xff, 0xe0, 0x00, 0x00, 0x00, 0x00, 0x00, 0x00, 0x01, 
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  0x00, 0x00, 0x00, 0x00, 0x00, 0x00, 0x00, 0x00, 0x00, 0x00, 0x00, 0x00, 0x00, 0x00, 0x00, 0x00
};

// Array of all bitmaps for convenience. (Total bytes used to store images in PROGMEM = 592)
const int epd_bitmap_allArray_LEN = 1;
const unsigned char* epd_bitmap_allArray[1] = {
  epd_bitmap_580b57fcd9996e24bc43c39c__1_
};


void setup() {
  Serial.begin(9600);
  SPI.begin();
  lectorRFID.PCD_Init();
  pantalla.begin(SSD1306_SWITCHCAPVCC, 0x3C);
  pantalla.display();
  delay(2000);
  pantalla.clearDisplay();
  
  // Mostrar la imagen en el menú principal
  pantalla.drawBitmap(0, 0, epd_bitmap_580b57fcd9996e24bc43c39c__1_, 67, 64, 1);
  pantalla.display();
  
  pinMode(PINLED, OUTPUT);
}

void loop() {
  if (millis() - ultimoMillisEscanear > TIEMPOLEDENCENDIDO) {
    digitalWrite(PINLED, LOW); // Apagar LED después de TIEMPOLEDENCENDIDO
    estadoLED = false;
    pantalla.clearDisplay();
    pantalla.drawBitmap(0, 0, epd_bitmap_580b57fcd9996e24bc43c39c__1_, 67, 64, 1);
    pantalla.display();
  }

  if (lectorRFID.PICC_IsNewCardPresent() && lectorRFID.PICC_ReadCardSerial()) {
    Serial.println("Tarjeta detectada");

    if (intentosEscanearHoy > 0) {
      // Decrementar el contador de intentos
      intentosEscanearHoy--;

      // Mostrar el número actual de intentos en la pantalla OLED
      pantalla.clearDisplay();
      pantalla.setTextSize(1);
      pantalla.setTextColor(SSD1306_WHITE);
      pantalla.setCursor(0,0);
      pantalla.println("ID de Tarjeta:");
      pantalla.println(obtenerIdTarjeta()); // Obtener y mostrar ID de la tarjeta
      pantalla.println("Intentos restantes: " + String(intentosEscanearHoy));
      pantalla.display();

      // Encender LED
      digitalWrite(PINLED, HIGH);
      estadoLED = true;
      ultimoMillisEscanear = millis();
    } else {
      // No hay más intentos disponibles, mostrar mensaje en la pantalla OLED
      pantalla.clearDisplay();
      pantalla.setTextSize(1);
      pantalla.setTextColor(SSD1306_WHITE);
      pantalla.setCursor(0,0);
      pantalla.println("Se han alcanzado el");
      pantalla.println("numero maximo de intentos");
      pantalla.println("de escaneo hoy");
      pantalla.display();
      delay(3000);
    }

    lectorRFID.PICC_HaltA(); // Detener la tarjeta actual
  }
}

// Función para obtener el ID de la tarjeta
String obtenerIdTarjeta() {
  String idTarjeta = "";
  for (byte i = 0; i < lectorRFID.uid.size; i++) {
    idTarjeta.concat(String(lectorRFID.uid.uidByte[i] < 0x10 ? "0" : ""));
    idTarjeta.concat(String(lectorRFID.uid.uidByte[i], HEX));
  }
  return idTarjeta;
}
